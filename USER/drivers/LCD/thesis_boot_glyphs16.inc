	{ 0xD3, 0xEB, 0x00, 0x00, 0x00, 0x00, 0x10, 0x00, 0x10, 0x00, 0xF0, 0x3F, 0x10, 0x00, 0x10, 0x00, 0xF0, 0x1F, 0x00, 0x10, 0xFC, 0x17, 0x00, 0x10, 0x00, 0x10, 0x80, 0x0F, 0x00, 0x00, 0x00, 0x00, 0x00, 0x00 }, /* 与 */
	{ 0xB5, 0xCD, 0x00, 0x00, 0x00, 0x00, 0x20, 0x30, 0xB0, 0x0F, 0x90, 0x04, 0x98, 0x04, 0x9C, 0x04, 0x94, 0x3F, 0x90, 0x04, 0x90, 0x04, 0x90, 0x2A, 0x90, 0x2B, 0x90, 0x34, 0x00, 0x00, 0x00, 0x00, 0x00, 0x00 }, /* 低 */
	{ 0xB9, 0xA6, 0x00, 0x00, 0x00, 0x01, 0x7C, 0x01, 0x10, 0x01, 0xD0, 0x1F, 0x10, 0x11, 0x10, 0x11, 0x10, 0x11, 0x10, 0x11, 0xF0, 0x11, 0x9C, 0x10, 0x40, 0x10, 0x20, 0x1E, 0x00, 0x00, 0x00, 0x00, 0x00, 0x00 }, /* 功 */
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	{ 0xA3, 0xBA, 0x00, 0x00, 0x00, 0x00, 0x00, 0x00, 0x00, 0x00, 0x00, 0x00, 0x30, 0x00, 0x30, 0x00, 0x00, 0x00, 0x00, 0x00, 0x30, 0x00, 0x30, 0x00, 0x00, 0x00, 0x00, 0x00, 0x00, 0x00, 0x00, 0x00, 0x00, 0x00 }, /* ： */
